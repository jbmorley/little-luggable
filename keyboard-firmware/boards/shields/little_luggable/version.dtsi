/*
 * Auto-generated by scripts/generate-about-macro.sh - do not edit by hand.
 *
 * Defines the &about macro, which types the firmware identity string:
 *
 *     Little Luggable 0.0.0 0
 *
 * The committed copy uses placeholder values; the build regenerates it with
 * the real version and build number.
 */

/ {
    macros {
        about: about {
            compatible = "zmk,behavior-macro";
            #binding-cells = <0>;
            label = "ABOUT";
            wait-ms = <10>;
            tap-ms = <30>;
            bindings
                = <&macro_tap
                    &kp LS(L)
                    &kp I
                    &kp T
                    &kp T
                    &kp L
                    &kp E
                    &kp SPACE
                    &kp LS(L)
                    &kp U
                    &kp G
                    &kp G
                    &kp A
                    &kp B
                    &kp L
                    &kp E
                    &kp SPACE
                    &kp N0
                    &kp DOT
                    &kp N0
                    &kp DOT
                    &kp N0
                    &kp SPACE
                    &kp N0
                >;
        };
    };
};
