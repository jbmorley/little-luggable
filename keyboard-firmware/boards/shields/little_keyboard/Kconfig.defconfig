## keyboard-firmware/boards/shields/little_keyboard/Kconfig.defconfig
```kconfig
if SHIELD_LITTLE_KEYBOARD

config BT
    default y

config ZMK_BLE
	default y

config ZMK_KEYBOARD_NAME
    default "Little Keyboard"

endif
```

## keyboard-firmware/boards/shields/little_keyboard/Kconfig.shield
```kconfig
config SHIELD_LITTLE_KEYBOARD
    def_bool $(shields_list_contains,little_keyboard)
```
