## config/boards/shields/little_luggable/Kconfig.defconfig
```kconfig
if SHIELD_LITTLE_LUGGABLE

config BT
    default y

config ZMK_BLE
	default y

config ZMK_KEYBOARD_NAME
    default "Little Luggable"

endif
```

## config/boards/shields/little_luggable/Kconfig.shield
```kconfig
config SHIELD_LITTLE_LUGGABLE
    def_bool $(shields_list_contains,little_luggable)
```
